## config/west.yml
```yaml
manifest:
  remotes:
    - name: zmkfirmware
      url-base: https://github.com/zmkfirmware
    - name: caksoylar
      url-base: https://github.com/caksoylar
    - name: tkk00
      url-base: https://github.com/tkk00

  projects:
    - name: zmk-pointing-acceleration
      remote: tkk00
      revision: main

    - name: zmk
      remote: zmkfirmware
      revision: main
      import: app/west.yml

    - name: zmk-rgbled-widget
      remote: caksoylar
      revision: main
```
